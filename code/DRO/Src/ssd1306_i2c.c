#include "../../DRO/Inc/ssd1306_i2c.h"

#include <i2c.h>
#include <string.h>
#include <stdlib.h>
#include <stdbool.h>

#include "../../DRO/Inc/calipers.h"
#include "../../DRO/Inc/fonts.h"

uint8_t DATAONLY = 0b01000000;
uint8_t COMMAND = 0b00000000;


uint8_t OLED_ADDRESS = DEFAULT_7bit_OLED_SLAVE_ADDRESS;

typedef struct{
  char Label;
  uint16_t Y;
} line;

static line *lines[3] =
  {
	&(line){'X', 0},
	&(line){'Y', 22},
	&(line){'Z', 44}
  };

/* Private SSD1306 structure */
typedef struct {
	uint16_t CurrentX;
	uint16_t CurrentY;
} SSD1306_t;

/* Private variable */
static SSD1306_t SSD1306;


static uint8_t screenRAM[SSD1306_WIDTH * SSD1306_HEIGHT / 8] = {
0x00, 0x00, 0x00, 0x00, 0x00, 0x00, 0x00, 0x00, 0x00, 0x00, 0x00, 0x00, 0x00, 0x00, 0x00, 0x00,
0x00, 0x00, 0x00, 0x00, 0x00, 0x00, 0x00, 0x00, 0x00, 0x00, 0x00, 0x00, 0x00, 0x00, 0x00, 0x00,
0x00, 0x00, 0x00, 0x00, 0x00, 0x00, 0x00, 0x00, 0x00, 0x00, 0x00, 0x00, 0x00, 0x00, 0x00, 0x00,
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0x00, 0x00, 0x00, 0x00, 0x00, 0x00, 0x00, 0x00, 0x00, 0x00, 0x00, 0x00, 0x00, 0x00, 0x00, 0x00
};

// uint32_t reg32 __attribute__((unused));

void ssd1306_send_command(uint8_t cmd) {
  HAL_I2C_Mem_Write_IT(&hi2c2, OLED_ADDRESS, 0x00, 1, &cmd, 1);
  while (HAL_I2C_GetState(&hi2c2) != HAL_I2C_STATE_READY){};

  /*
  ssd1306_start();
  ssd1306_send(0x00);
  ssd1306_send(cmd);
  ssd1306_stop();
  */
}

void ssd1306_init() {
  OLED_ADDRESS = DEFAULT_7bit_OLED_SLAVE_ADDRESS;
  
  
  /* Init LCD */
  ssd1306_send_command(0xAE); //display off
  ssd1306_send_command(0x20); //Set Memory Addressing Mode   
  ssd1306_send_command(0x10); //00,Horizontal Addressing Mode;01,Vertical Addressing Mode;10,Page Addressing Mode (RESET);11,Invalid
  ssd1306_send_command(0xB0); //Set Page Start Address for Page Addressing Mode,0-7
  ssd1306_send_command(0xC8); //Set COM Output Scan Direction
  ssd1306_send_command(0x02); //---set low column address
  ssd1306_send_command(0x10); //---set high column address
  ssd1306_send_command(0x40); //--set start line address
  ssd1306_send_command(0x81); //--set contrast control register
  ssd1306_send_command(0xFF);
  ssd1306_send_command(0xA1); //--set segment re-map 0 to 127
  ssd1306_send_command(0xA6); //--set normal display
  ssd1306_send_command(0xA8); //--set multiplex ratio(1 to 64)
  ssd1306_send_command(0x3F); //
  ssd1306_send_command(0xA4); //0xa4,Output follows RAM content;0xa5,Output ignores RAM content
  ssd1306_send_command(0xD3); //-set display offset
  ssd1306_send_command(0x00); //-not offset
  ssd1306_send_command(0xD5); //--set display clock divide ratio/oscillator frequency
  ssd1306_send_command(0xF0); //--set divide ratio
  ssd1306_send_command(0xD9); //--set pre-charge period
  ssd1306_send_command(0x22); //
  ssd1306_send_command(0xDA); //--set com pins hardware configuration
  ssd1306_send_command(0x12);
  ssd1306_send_command(0xDB); //--set vcomh
  ssd1306_send_command(0x20); //0x20,0.77xVcc
  ssd1306_send_command(0x8D); //--set DC-DC enable
  ssd1306_send_command(0x14); //
  ssd1306_send_command(0xAF); //--turn on SSD1306 panel
 
  SSD1306.CurrentX = 0;
  SSD1306.CurrentY = 0;
  ssd1306_refresh();

  // Reset adressing mode to Horizontal
  // ssd1306_send_command(0x20); //Set Memory Addressing Mode   
  // ssd1306_send_command(0x00); //00,Horizontal Addressing Mode;01,Vertical Addressing Mode;10,Page Addressing Mode (RESET);11,Invalid

  // Set Column Address Scope
  ssd1306_send_command(0x21);
  ssd1306_send_command(0);
  ssd1306_send_command(SSD1306_WIDTH-1);

  // Set Page Address Scope
  ssd1306_send_command(0x22);
  ssd1306_send_command(0);
  ssd1306_send_command(SSD1306_HEIGHT/8-1);
  
}

void ssd1306_clear(void) {
  memset(screenRAM, 0x00, sizeof(screenRAM));
}

/**
 * Send (and display if OLED is ON) RAM buffer to device
 */
void ssd1306_refresh(void) {
  for (uint8_t m = 0; m < 8; m++)
  {
	ssd1306_send_command(0xB0 + m);
	ssd1306_send_command(0x02);
	ssd1306_send_command(0x10);
	HAL_I2C_Mem_Write_IT(&hi2c2, OLED_ADDRESS, 0x40, 1, &screenRAM[SSD1306_WIDTH * m],  SSD1306_WIDTH);
	while (HAL_I2C_GetState(&hi2c2) != HAL_I2C_STATE_READY){};
  }
}

void ssd1306_drawpixel(uint16_t x, uint16_t y, SSD1306_COLOR_t color) {
  if (x >= SSD1306_WIDTH || y >= SSD1306_HEIGHT) {
    return;
  }
  
  if (color == white) {
    screenRAM[x + (y / 8) * SSD1306_WIDTH] |= 1 << (y % 8);
  } else {
    screenRAM[x + (y / 8) * SSD1306_WIDTH] &= ~(1 << (y % 8));
  }
}

void ssd1306_gotoxy(uint16_t x, uint16_t y) {
  /* Set write pointers */
  SSD1306.CurrentX = x;
  SSD1306.CurrentY = y;
}

char ssd1306_drawchar(char ch, uint8_t color) {
  uint32_t i, b, j;
  
  b = 0;
  for (i = 0; i < Font->FontHeight; i++) {
	for (j = 0; j < Font->FontWidth; j++) {
      if ((Font->data[(ch-32)*Font->CharBytes + b/8] >> b%8) & 1) {
		ssd1306_drawpixel(SSD1306.CurrentX + j, (SSD1306.CurrentY + i), (uint8_t) color);
      } else {
        ssd1306_drawpixel(SSD1306.CurrentX + j, (SSD1306.CurrentY + i), (uint8_t)!color);
      }
      b++;
    }
  }
  return ch;
}

char ssd1306_drawstring(char* str) {
  while (*str) {
    if (ssd1306_drawchar(*str, white) != *str) {
      return *str;
    }
    str++;
	SSD1306.CurrentX += Font->FontWidth;
  }
  return *str;
}

bool ssd1306_drawhmm(uint8_t line, volatile caliper* cal) {
  char digit;
  char digitsdrawn = 0;
  char sign = '+';
  bool changed = cal->changed;
  if (changed) {
	  SSD1306.CurrentY = lines[line]->Y;
	  SSD1306.CurrentX = SSD1306_WIDTH - Font->FontWidth;
	  
	  int16_t number = cal->current;
	  if (number < 0) {
		sign = '-';
		number *= -1;
	  }
	  
	  
	  while (digitsdrawn < 5) {
		digit = number % 10;
		number /= 10;
		ssd1306_drawchar(digit+0x30, white);
		SSD1306.CurrentX -= Font->FontWidth;
		++digitsdrawn;
		if (digitsdrawn == 2) {
		  ssd1306_drawchar('.', white);
		  SSD1306.CurrentX -= Font->FontWidth;
		}
	  }
	  
	  ssd1306_drawchar(sign, white);
	  SSD1306.CurrentX -= Font->FontWidth;
	  
	  ssd1306_drawchar(0x20, white);
	  SSD1306.CurrentX -= Font->FontWidth;
	  
	  ssd1306_drawchar(0x20, white);
	  SSD1306.CurrentX -= Font->FontWidth;
	  
	  ssd1306_drawchar(lines[line]->Label, white);
	  cal->changed = false;
  }
  return changed;
}
